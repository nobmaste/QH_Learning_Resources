//-----------------------------------------------------------------
// 程序描述:
// 　　51_AD9854测试程序_V2.0
// 作　　者: 凌智电子
// 开始日期: 2017-06-1
// 完成日期: 2017-06-5
// 修改日期: 2017-06-5
// 当前版本: V2.0
// 历史版本:
// 　- V1.0: 基本的AD9854并行控制输出，液晶显示功能
// 　- V1.1：并行控制转串行控制
// 　- V2.0: 测试AD9854各个调制波形输出功能
// 调试工具: 51开发板、1602液晶屏
// 说　　明: 
//				(1) 调试使用的系统时钟频率Fsysclk=12MHz;
//     		(2) AD9854的数据传输方式:并行传输方式;
//				(3) AD9854_IO与51开发板连接方式如32-40行代码提示连接
//        (4) 本测试程序实现各个调制波形输出功能,通过按键'K2'控制切换输出调制波形
//-----------------------------------------------------------------

//-----------------------------------------------------------------
// 头文件包含
//-----------------------------------------------------------------
#include <reg52.h>
#include <key.h>
#include <init.h>
#include <AD9854.h>
//-----------------------------------------------------------------
//               IO 连接说明
//-----------------------------------------------------------------
//    AD9854         |      51         
//   ADDER_BUS[5:0]    -->   P0{5:0}
//   DATA_BUS[7:0]     -->   P1{7:0}
//   AD9854_RST         -->   P2^0;    		
//   AD9854_SP          -->   P2^1;
//   AD9854_OSK         -->   P2^2; 			//osk
//   AD9854_UDCLK       -->   P2^4; 
//   AD9854_WR          -->   P0^7;
//   AD9854_FDATA       -->   P2^6;       //fsk/bpsk/hold
//   AD9854_RD          -->   P2^7;
//-----------------------------------------------------------------


//-----------------------------------------------------------------
// 主程序
//-----------------------------------------------------------------
void main(void)
{  
	uchar key_value = 0,key_count = 0;
	
  init();
	LCD_Clear();//清屏
	LCD_Write_String(1, 0,"  AD9854 TEST!  ");
	LCD_Write_String(1, 1,"K2:  Select Wave");
	
  while (1)
  {
		key_value = Key_Scan ();				           // 获取键值
		if(key_value==1)
		{
			key_count ++;
			LCD_Write_String(1, 1,"                 ");	
			switch (key_count)
  	  {
			 	case  1 :	{                             
   	  			        AD9854_Init();                      
                    AD9854_SetSine (1000000, 4050);     				// AD9854正弦波点频输出，1M500 mv	  	
										LCD_Write_String(2, 1,"     SINE        ");
  	              }break;
  	   case  2 :	{
   				          AD9854_InitFSK();
 										AD9854_SetFSK(10000,100000);								//FDATA高电平输出100k，低电平输出10k，控制信号1k方波 	
										LCD_Write_String(2, 1,"     FSK         ");
  	              }break;
  	   case  3 :	{
  	  			        AD9854_InitBPSK();                      
                    AD9854_SetBPSK(0, 8192);    								// FDATA高电平，相位为0，低电平相位为180	  	
										LCD_Write_String(2, 1,"     BPSK        ");                  
                  }break;
  	   case  4 :	{
  				          AD9854_InitRFSK();                      
                    AD9854_SetRFSK(1000000,40000000,100000,524288);  // FDATA为低电平为增斜率，高电平为降斜率 	
										LCD_Write_String(2, 1,"     RFSK        ");    
				           
                  }break;
  	   case  5 :	{
				               
  	  			        AD9854_InitAM();
										AD9854_SetAM(4000);										  			//am	
				            LCD_Write_String(2, 1,"      A M        ");  
										
                  }break;
  	   case  6 :	{
  				          AD9854_InitOSK();                     
                    AD9854_SetOSK (100);    										 // OSK高电平，幅值增加；低电平幅值减少，100为变化的斜率（满幅输出） 		
										LCD_Write_String(2, 1,"      OSK        ");     
                   }break;
		   case  7 :	{
  				          AD9854_InitChirp();                     
                    AD9854_SetChirp (1000000,100000,524288);   //FDATA高电平，信号频率停止；	  	
										LCD_Write_String(2, 1,"     CHIRP        ");
										key_count= 0 ;
                   }break;
  	    default :	break;
		  }
		}	
     
		}	    		
  }


//-----------------------------------------------------------------
// End Of File
//-----------------------------------------------------------------


