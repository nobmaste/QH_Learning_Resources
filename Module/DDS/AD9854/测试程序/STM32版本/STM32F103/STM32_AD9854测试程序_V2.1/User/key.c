//-----------------------------------------------------------------
// 程序描述:
// 　　独立键盘驱动程序
// 作　　者: 凌智电子
// 开始日期: 2014-02-1
// 完成日期: 2014-02-2
// 修改日期: 2014-02-2
// 当前版本: V1.0
// 历史版本:
// 　- V1.0: 独立键盘扫描,键值返回
// 调试工具: 凌智STM3核心开发板、1602液晶屏、LZE_ST_LINK2
// 说　　明: 
//				
//-----------------------------------------------------------------

//-----------------------------------------------------------------
// 头文件包含
//-----------------------------------------------------------------
#include "key.h"
#include "delay.h"

//-----------------------------------------------------------------
// void Key_Init(void)
//-----------------------------------------------------------------
//
// 函数功能: 初始化独立键盘端口
// 入口参数: 无
// 返回参数: 无
// 全局变量: 无
// 调用模块: 无    
// 注意事项: 无
//-----------------------------------------------------------------
void Key_Init(void)
{
	GPIO_InitTypeDef GPIO_InitStructure;

	RCC_APB2PeriphClockCmd(RCC_APB2Periph_GPIOE,ENABLE);		// 开启GPIOE时钟

	GPIO_InitStructure.GPIO_Pin = GPIO_Pin_0|GPIO_Pin_1|
																GPIO_Pin_2|GPIO_Pin_3;
	GPIO_InitStructure.GPIO_Mode = GPIO_Mode_IPU;						// 设置为上拉输入
	GPIO_InitStructure.GPIO_Speed = GPIO_Speed_50MHz;				// 时钟50MHz
	GPIO_Init(GPIOE,&GPIO_InitStructure);
}

//-----------------------------------------------------------------
// u8 Key_Scan(void)
//-----------------------------------------------------------------
//
// 函数功能: 独立键盘扫描
// 入口参数: 无
// 返回参数: rst：键值
// 全局变量: 无
// 调用模块: 无    
// 注意事项: 无
//-----------------------------------------------------------------
u8 Key_Scan(void)
{
	u8 rst = 0;
	
	// 按键隐藏优先级为KEY1>KEY2>KEY3>KEY4
	if((KEY1==0) || (KEY2==0) || (KEY3==0) || (KEY4==0))
	{
		Delay_1ms(10);			// 延时10ms去抖动
		if(KEY1 == 0)				// KEY1按下
		{
			rst = 1;
			while(KEY1 == 0); // 松手检测
		}
		if(KEY2 == 0)
		{
			rst = 2;
			while(KEY2 == 0);
		}
		if(KEY3 == 0)
		{
			rst = 3;
			while(KEY3 == 0);
		}
		if(KEY4 == 0)
		{
			rst = 4;
			while(KEY4 == 0);
		}
	}
	else
		rst = 0;
	return rst;
}
//-----------------------------------------------------------------
// End Of File
//-----------------------------------------------------------------
