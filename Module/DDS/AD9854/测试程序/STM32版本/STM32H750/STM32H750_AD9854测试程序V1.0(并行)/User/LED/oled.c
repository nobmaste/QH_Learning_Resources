//-----------------------------------------------------------------
// 程序描述:
//     OLED显示驱动程序
// 作    者: 凌智电子
// 开始日期: 2018-08-04
// 完成日期: 2018-08-04
// 修改日期: 
// 当前版本: V1.0
// 历史版本:
//  - V1.0: (2018-08-04)	OLED显示驱动
// 调试工具: 凌智STM32F429+CycloneIV电子系统设计开发板、LZE_ST_LINK2
// 说    明: 
//    
//-----------------------------------------------------------------

//-----------------------------------------------------------------
// 头文件包含
//-----------------------------------------------------------------
#include "oled.h"
#include "delay.h"
#include "oledfont.h"
//-----------------------------------------------------------------

//-----------------------------------------------------------------
// void IIC_Delay(void)
//-----------------------------------------------------------------
// 
// 函数功能: 控制I2C速度的延时
// 入口参数: 无 
// 返 回 值: 无
// 注意事项: 无
//
//-----------------------------------------------------------------
void IIC_Delay(void)
{
	u8 i=5;
	while(i--);
} 

//-----------------------------------------------------------------
// void IIC_Start(void)
//-----------------------------------------------------------------
// 
// 函数功能: 产生IIC起始信号
// 入口参数: 无 
// 返 回 值: 无
// 注意事项: 无
//
//-----------------------------------------------------------------
void IIC_Start(void)
{
	OLED_SCLK_H;
	OLED_SDIN_H;
	IIC_Delay();
	OLED_SDIN_L;
	IIC_Delay();
	OLED_SCLK_L;
}

//-----------------------------------------------------------------
// void IIC_Stop(void)
//-----------------------------------------------------------------
// 
// 函数功能: 产生IIC停止信号
// 入口参数: 无 
// 返 回 值: 无
// 注意事项: 无
//
//-----------------------------------------------------------------
void IIC_Stop(void)
{
	OLED_SCLK_L;
	OLED_SDIN_L;
	IIC_Delay();
	OLED_SCLK_H;
	IIC_Delay();
	OLED_SDIN_H;
}

//-----------------------------------------------------------------
// void IIC_Wait_Ack(void)
//-----------------------------------------------------------------
// 
// 函数功能: 等待应答信号到来
// 入口参数: 无 
// 返 回 值: 无
// 注意事项: 无
//
//-----------------------------------------------------------------
void IIC_Wait_Ack(void)
{
	OLED_SCLK_H;
	IIC_Delay();
	OLED_SCLK_L;
}

//-----------------------------------------------------------------
// void IIC_Send_Byte(u8 txd)
//-----------------------------------------------------------------
// 
// 函数功能: IIC发送一个字节
// 入口参数: u8 txd：发送的字节
// 返 回 值: 无
// 注意事项: 无
//
//-----------------------------------------------------------------
void IIC_Send_Byte(u8 txd)
{                        
  u8 t,da;   	    
  OLED_SCLK_L;// 拉低时钟开始数据传输 
	da=txd;
	for(t=0;t<8;t++)
	{ 
		if(da&0x80)
		{
			OLED_SDIN_H;
		}
		else
		{
			OLED_SDIN_L;
		}
		da<<=1; 
		IIC_Delay();		
		OLED_SCLK_H; 
		IIC_Delay();
		OLED_SCLK_L;	 
		IIC_Delay();
	}	 
} 

//-----------------------------------------------------------------
// void IIC_Send_Command(u8 IIC_Command)
//-----------------------------------------------------------------
// 
// 函数功能: IIC发送命令
// 入口参数: u8 IIC_Command：发送的命令
// 返 回 值: 无
// 注意事项: 无
//
//-----------------------------------------------------------------
void IIC_Send_Command(u8 IIC_Command)
{
	IIC_Start();
	IIC_Send_Byte(0x78);
	IIC_Wait_Ack();
	IIC_Send_Byte(0x00);
	IIC_Wait_Ack();
	IIC_Send_Byte(IIC_Command);
	IIC_Wait_Ack();
	IIC_Stop();
}

//-----------------------------------------------------------------
// void IIC_Send_Data(u8 IIC_Data)
//-----------------------------------------------------------------
// 
// 函数功能: IIC发送数据
// 入口参数: u8 IIC_Data：发送的数据
// 返 回 值: 无
// 注意事项: 无
//
//-----------------------------------------------------------------
void IIC_Send_Data(u8 IIC_Data)
{
	IIC_Start();
	IIC_Send_Byte(0x78);
	IIC_Wait_Ack();
	IIC_Send_Byte(0x40);
	IIC_Wait_Ack();
	IIC_Send_Byte(IIC_Data);
	IIC_Wait_Ack();
	IIC_Stop();
}

//-----------------------------------------------------------------
// void OLED_WR_Byte(u8 Data,u8 CMD)
//-----------------------------------------------------------------
// 
// 函数功能: OLED发送数据或命令
// 入口参数: u8 Data：数据或命令
//					 u8 CMD：数据命令选择信号
// 返 回 值: 无
// 注意事项: 无
//
//-----------------------------------------------------------------
void OLED_WR_Byte(u8 Data,u8 CMD)
{
	if(CMD)
		IIC_Send_Data(Data);
	else
		IIC_Send_Command(Data);
}

//-----------------------------------------------------------------
// void Fill_Picture(u8 Fill_Data)
//-----------------------------------------------------------------
// 
// 函数功能: 填写图片
// 入口参数: u8 Fill_Data：图片数据
// 返 回 值: 无
// 注意事项: 无
//
//-----------------------------------------------------------------
void Fill_Picture(u8 Fill_Data)
{
	u8 m,n;
	for(m=0;m<8;m++)
	{
		OLED_WR_Byte(0xb0+m,0);
		OLED_WR_Byte(0x00,0);
		OLED_WR_Byte(0x10,0);
		for(n=0;n<128;n++)
		{
			OLED_WR_Byte(Fill_Data,1);
		}
	}
}

//-----------------------------------------------------------------
// void OLED_Set_Pos(u8 x,u8 y) 
//-----------------------------------------------------------------
// 
// 函数功能: 坐标设置
// 入口参数: u8 x：X坐标
//					 u8 y：Y坐标
// 返 回 值: 无
// 注意事项: 无
//
//-----------------------------------------------------------------
void OLED_Set_Pos(u8 x,u8 y) 
{
	OLED_WR_Byte(0xb0+y,OLED_CMD);
	OLED_WR_Byte(((x&0xf0)>>4)|0x10,OLED_CMD);
	OLED_WR_Byte((x&0x0f),OLED_CMD); 
}

//-----------------------------------------------------------------
// void OLED_Display_On(void)
//-----------------------------------------------------------------
// 
// 函数功能: 开启OLED显示
// 入口参数: 无
// 返 回 值: 无
// 注意事项: 无
//
//-----------------------------------------------------------------
void OLED_Display_On(void)
{
	OLED_WR_Byte(0X8D,OLED_CMD);  // SET DCDC命令
	OLED_WR_Byte(0X14,OLED_CMD);  // DCDC ON
	OLED_WR_Byte(0XAF,OLED_CMD);  // DISPLAY ON
}

//-----------------------------------------------------------------
// void OLED_Display_Off(void)
//-----------------------------------------------------------------
// 
// 函数功能: 关闭OLED显示
// 入口参数: 无
// 返 回 值: 无
// 注意事项: 无
//
//-----------------------------------------------------------------
void OLED_Display_Off(void)
{
	OLED_WR_Byte(0X8D,OLED_CMD);  // SET DCDC命令
	OLED_WR_Byte(0X10,OLED_CMD);  // DCDC OFF
	OLED_WR_Byte(0XAE,OLED_CMD);  // DISPLAY OFF
}

//-----------------------------------------------------------------
// void OLED_Clear(void)
//-----------------------------------------------------------------
// 
// 函数功能: 清屏函数
// 入口参数: 无
// 返 回 值: 无
// 注意事项: 清完屏,整个屏幕是黑色的!和没点亮一样!!!	
//
//-----------------------------------------------------------------
void OLED_Clear(void)
{
	u8 i,n;		    
	for(i=0;i<8;i++)  
	{  
		OLED_WR_Byte (0xb0+i,OLED_CMD);    // 设置页地址（0~7）
		OLED_WR_Byte (0x00,OLED_CMD);      // 设置显示位置—列低地址
		OLED_WR_Byte (0x10,OLED_CMD);      // 设置显示位置—列高地址   
		for(n=0;n<128;n++)
		{
			OLED_WR_Byte(0,OLED_DATA); 
		}
	}
}

//-----------------------------------------------------------------
// void OLED_On(void)
//-----------------------------------------------------------------
// 
// 函数功能: 清屏函数
// 入口参数: 无
// 返 回 值: 无
// 注意事项: 清完屏,整个屏幕是都被点亮!!!	
//
//-----------------------------------------------------------------
void OLED_On(void)  
{  
	u8 i,n;		    
	for(i=0;i<8;i++)  
	{  
		OLED_WR_Byte (0xb0+i,OLED_CMD);    // 设置页地址（0~7）
		OLED_WR_Byte (0x00,OLED_CMD);      // 设置显示位置—列低地址
		OLED_WR_Byte (0x10,OLED_CMD);      // 设置显示位置—列高地址   
		for(n=0;n<128;n++)
		{
			OLED_WR_Byte(1,OLED_DATA); 
		}
	} //更新显示
}

//-----------------------------------------------------------------
// void OLED_ShowChar(u8 x,u8 y,u8 chr,u8 Char_Size)
//-----------------------------------------------------------------
// 
// 函数功能: 在指定位置显示一个字符,包括部分字符
// 入口参数: u8 x：X轴坐标(0~127)
//					 u8 y：Y轴坐标(0~7)
//					 u8 chr：字符
//					 u8 Char_Size：字体大小（16/12）
// 返 回 值: 无
// 注意事项: 无
//
//-----------------------------------------------------------------
void OLED_ShowChar(u8 x,u8 y,u8 chr,u8 Char_Size)
{
	u8 c=0,i=0;	
	c=chr-' ';// 得到偏移后的值			
	if(x>Max_Column)
	{
		x=0;
		y=y+2;
	}
	if(Char_Size ==16)
	{
		OLED_Set_Pos(x,y);	
		for(i=0;i<8;i++)
		{
			
			OLED_WR_Byte(F8X16[c*16+i],OLED_DATA);
		}
		OLED_Set_Pos(x,y+1);
		for(i=0;i<8;i++)
		{
			OLED_WR_Byte(F8X16[c*16+i+8],OLED_DATA);
		}
	}
	else 
	{	
		OLED_Set_Pos(x,y);
		for(i=0;i<6;i++)
		{
			OLED_WR_Byte(F6x8[c][i],OLED_DATA);		
		}
	}
}

//-----------------------------------------------------------------
// u32 oled_pow(u8 m,u8 n)
//-----------------------------------------------------------------
// 
// 函数功能: m^n函数
// 入口参数: 无
// 返 回 值: 无
// 注意事项: 无
//
//-----------------------------------------------------------------
u32 oled_pow(u8 m,u8 n)
{
	u32 result=1;	 
	while(n--)
		result*=m;    
	return result;
}	

//-----------------------------------------------------------------
// void OLED_ShowNum(u8 x,u8 y,u32 num,u8 len,u8 size2)
//-----------------------------------------------------------------
// 
// 函数功能: 显示2个数字
// 入口参数: u8 x：X轴坐标(0~127)
//					 u8 y：Y轴坐标(0~7)
//					 u32 num：数字
//					 u8 len：数字的位数
//					 u8 size2：字体大小（16/12）
// 返 回 值: 无
// 注意事项: 无
//
//-----------------------------------------------------------------
void OLED_ShowNum(u8 x,u8 y,u32 num,u8 len,u8 size2)
{
	u8 t,temp;
	u8 enshow=0;						   
	for(t=0;t<len;t++)
	{
		temp=(num/oled_pow(10,len-t-1))%10;
		if(enshow==0&&t<(len-1))
		{
			if(temp==0)
			{
				OLED_ShowChar(x+(size2/2)*t,y,' ',size2);
				continue;
			}
			else 
				enshow=1; 
		}
	 	OLED_ShowChar(x+(size2/2)*t,y,temp+'0',size2); 
	}
}

//-----------------------------------------------------------------
// void OLED_ShowString(u8 x,u8 y,u8 *chr,u8 Char_Size)
//-----------------------------------------------------------------
// 
// 函数功能: 显示一个字符号串
// 入口参数: u8 x：X轴坐标(0~127)
//					 u8 y：Y轴坐标(0~7)
//					 u8 *chr：字符地址
//					 u8 Char_Size：字体大小（16/12）
// 返 回 值: 无
// 注意事项: 无
//
//-----------------------------------------------------------------
void OLED_ShowString(u8 x,u8 y,char *chr,u8 Char_Size)
{
	unsigned char j=0;
	while (chr[j]!='\0')
	{		
		OLED_ShowChar(x,y,chr[j],Char_Size);
		x+=8;
		if(x>120){x=0;y+=2;}
			j++;
	}
}

//-----------------------------------------------------------------
// void OLED_ShowCHinese(u8 x,u8 y,u8 no)
//-----------------------------------------------------------------
// 
// 函数功能: 显示汉字
// 入口参数: u8 x：X轴坐标(0~127)
//					 u8 y：Y轴坐标(0~7)
//					 u8 no：字
// 返 回 值: 无
// 注意事项: 无
//
//-----------------------------------------------------------------
void OLED_ShowCHinese(u8 x,u8 y,u8 no)
{      			    
	u8 t;
	OLED_Set_Pos(x,y);
	for(t=0;t<16;t++)
	{
		
		OLED_WR_Byte(Hzk[2*no][t],OLED_DATA);
	}	
		
	OLED_Set_Pos(x,y+1);
	for(t=0;t<16;t++)
	{	
		
		OLED_WR_Byte(Hzk[2*no+1][t],OLED_DATA);
	}					
}

//-----------------------------------------------------------------
// void OLED_Init(void)
//-----------------------------------------------------------------
// 
// 函数功能: OLED初始化
// 入口参数: 无 
// 返 回 值: 无
// 注意事项: 无
//           VCC->3V3/+5V		GND->GND  SCL->PC0  SDA->PC2
//
//-----------------------------------------------------------------
void OLED_Init(void)
{
	GPIO_InitTypeDef GPIO_Initure;
	__HAL_RCC_GPIOC_CLK_ENABLE();           	// 开启GPIOC时钟

	GPIO_Initure.Pin=GPIO_PIN_0 | GPIO_PIN_2;	// PC0->SCL PC2->SDA
	GPIO_Initure.Mode=GPIO_MODE_OUTPUT_OD;  	// 开漏输出
	GPIO_Initure.Pull=GPIO_PULLUP;          	// 上拉
	GPIO_Initure.Speed=GPIO_SPEED_FREQ_HIGH;  // 高速
	HAL_GPIO_Init(GPIOC,&GPIO_Initure);				// 初始化
	
	OLED_SCLK_H;
	OLED_SDIN_H;
	
	delay_ms(200);

	OLED_WR_Byte(0xAE,OLED_CMD);// 关闭显示
	
	OLED_WR_Byte(0x00,OLED_CMD);// 设置低列地址
	OLED_WR_Byte(0x10,OLED_CMD);// 设置高列地址
	
	OLED_WR_Byte(0x40,OLED_CMD);// 设置起始行地址 
	OLED_WR_Byte(0xB0,OLED_CMD);// 设置页地址
	
	OLED_WR_Byte(0x81,OLED_CMD);// 设置对比度控制
	OLED_WR_Byte(0xFF,OLED_CMD);// 128 
  
	OLED_WR_Byte(0xA1,OLED_CMD);// 设置段重映射
	
	OLED_WR_Byte(0xA6,OLED_CMD);// 设置正常/反向显示
	
	OLED_WR_Byte(0xA8,OLED_CMD);// 设置驱动路数
	OLED_WR_Byte(0x3F,OLED_CMD);// 默认0x3F(1/64)
	
	OLED_WR_Byte(0xC8,OLED_CMD);// 设置COM扫描方向;bit3:0,普通模式;1,重定义模式 COM[N-1]->COM0;N:驱动路数
	
	OLED_WR_Byte(0xD3,OLED_CMD);// 设置显示偏移
	OLED_WR_Byte(0x00,OLED_CMD);// 默认为0
	
	OLED_WR_Byte(0xD5,OLED_CMD);// 设置时钟分频因子,震荡频率
	OLED_WR_Byte(0x80,OLED_CMD);// [3:0],分频因子;[7:4],震荡频率
	
	OLED_WR_Byte(0xD8,OLED_CMD);// 电荷泵设置
	OLED_WR_Byte(0x05,OLED_CMD);// bit2，开启/关闭
	
	OLED_WR_Byte(0xD9,OLED_CMD);// 设置预充电周期
	OLED_WR_Byte(0xF1,OLED_CMD);// [3:0],PHASE 1;[7:4],PHASE 2;
	
	OLED_WR_Byte(0xDA,OLED_CMD);// 设置COM硬件引脚配置
	OLED_WR_Byte(0x12,OLED_CMD);// [5:4]配置	
	
	OLED_WR_Byte(0xDB,OLED_CMD);// 设置VCOMH 电压倍率
	OLED_WR_Byte(0x30,OLED_CMD);// [6:4] 000,0.65*vcc;001,0.77*vcc;011,0.83*vcc;
	
	OLED_WR_Byte(0x8D,OLED_CMD);// 电荷泵设置
	OLED_WR_Byte(0x14,OLED_CMD);// bit2，开启/关闭
	
	OLED_WR_Byte(0xAF,OLED_CMD);// 开启显示
}

//-----------------------------------------------------------------
// End Of File
//-----------------------------------------------------------------
